## board/samsung/tiny210/Kconfig
```kconfig
if TARGET_TINY210

config SYS_CPU
	default "armv7"

config SYS_BOARD
	default "tiny210"

config SYS_VENDOR
	default "samsung"

config SYS_SOC
	default "s5p210"

config SYS_CONFIG_NAME
	default "tiny210"

endif
```

## configs/tiny210_defconfig
```kconfig
CONFIG_ARM=y
CONFIG_TARGET_TINY210=y
CONFIG_DEFAULT_DEVICE_TREE="s5p210-tiny210"
CONFIG_OF_CONTROL=y
CONFIG_OF_EMBED=y
```
